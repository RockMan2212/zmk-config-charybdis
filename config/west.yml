## config/west.yml
```yaml
manifest:
  remotes:
    - name: zmkfirmware
      url-base: https://github.com/zmkfirmware
    - name: badjeff
      url-base: https://github.com/badjeff

  projects:
    - name: zmk
      remote: zmkfirmware
      revision: v0.3
      import: app/west.yml
    
    # Charybdis 트랙볼 센서(PMW3610)용 최신 드라이버
    - name: zmk-pmw3610-driver
      remote: badjeff
      revision: zmk-0.3

  self:
    path: config
```
